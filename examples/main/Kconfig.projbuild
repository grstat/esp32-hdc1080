## examples/main/Kconfig.projbuild
```kconfig
menu "HDC1080 Example Config"

    config HDC1080_I2C_SCL
        int "HDC1080 I2C SCL"
        default 22
        help
            The I2C SCL pin number of the HDC1080

    config HDC1080_I2C_SDA
        int "HDC1080 I2C SDA"
        default 21
        help
            The I2C SDA pin number of the HDC1080

    config HDC1080_I2C_PORT_NUMBER
        int "HDC1080 I2C PORT NUMBER"
        default 0
        help
            The I2C port number to use

    config HDC1080_I2C_PORT_FREQUENCY
        int "HDC1080 I2C PORT FREQUENCY"
        default 400000
        help
            The I2C port frequency. The default is 400kHz

    config HDC1080_I2C_PULLUPS
        int "Enable or disable pullups on the I2C data lines"
        default 1
        help
            Use 1 to enable pullups, 0 to disable. This value
            changes both the SDA and SCL pullup values

    config HDC1080_I2C_SCAN_FOR_DEVICES
        bool "Perform I2C device scan after configuration"
        default y
        help
            Enable to run the device scan during I2C initalization.
            The device scan allows you to see all device IDs connected
            to the I2C bus via console print.

endmenu
```
